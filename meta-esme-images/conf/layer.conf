## meta-esme-images/conf/layer.conf
```bitbake
# We have a conf and classes directory, add to BBPATH
BBPATH .= ":${LAYERDIR}"

# We have recipes-* directories, add to BBFILES
BBFILES += "${LAYERDIR}/recipes-*/*/*.bb \
            ${LAYERDIR}/recipes-*/*/*.bbappend"

BBFILE_COLLECTIONS += "meta-esme-images"
BBFILE_PATTERN_meta-esme-images = "^${LAYERDIR}/"
BBFILE_PRIORITY_meta-esme-images = "6"

LAYERDEPENDS_meta-esme-images = "core"
LAYERSERIES_COMPAT_meta-esme-images = "scarthgap"
BBFILE_PRIORITY_meta-esme-images = "60"
```
